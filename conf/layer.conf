## conf/layer.conf
```bitbake
# We have a conf and classes directory, add to BBPATH
BBPATH .= ":${LAYERDIR}"

# We have recipes-* directories, add to BBFILES
BBFILES += "${LAYERDIR}/recipes-*/*/*.bb \
	    ${LAYERDIR}/recipes-*/*/*.bbappend"

BBFILE_PRIORITY_iei-rk-bsp = "10"

BBFILE_COLLECTIONS += "iei-rk-bsp"
BBFILE_PATTERN_iei-rk-bsp := "^${LAYERDIR}"

LAYERSERIES_COMPAT_iei-rk-bsp = "scarthgap"
```

## conf/machine/wafer-rk3588.conf
```bitbake
# Copyright (c) 2024, IEI World, Ltd.
# LC Wang <lcwang@ieiworld.com>
# Released under the MIT license (see COPYING.MIT for the terms)

#@TYPE: Machine
#@NAME: WAFER-RK3588

require conf/machine/include/rk3588.inc

PREFERRED_VERSION_linux-rockchip = "6.1%"
LINUXLIBCVERSION = "6.1-custom%"

KERNEL_DEVICETREE = "rockchip/rk3588-b675.dtb"
KBUILD_DEFCONFIG = "iei_ubuntu_defconfig"

UBOOT_MACHINE = "rk3588_b675_defconfig"

RK_WIFIBT_RRECOMMENDS = " \
    rkwifibt-firmware-ap6275p-wifi \
    rkwifibt-firmware-ap6275-bt \
    brcm-tools \
"
```
