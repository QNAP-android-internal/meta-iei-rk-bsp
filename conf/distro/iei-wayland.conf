## conf/distro/iei-wayland.conf
```bitbake
require conf/distro/poky.conf

SDK_VENDOR = "-ieisdk"
SDK_VERSION = "${@d.getVar('DISTRO_VERSION').replace('snapshot-${METADATA_REVISION}', 'snapshot')}"
SDK_VERSION[vardepvalue] = "${SDK_VERSION}"

MAINTAINER = "lcwang <zaq14760@gmail.com>"

TARGET_VENDOR = "-iei"

LOCALCONF_VERSION = "2"

# Override these in poky based distros
POKY_DEFAULT_DISTRO_FEATURES = "largefile opengl ptest multiarch wayland vulkan"
POKY_DEFAULT_EXTRA_RDEPENDS = "packagegroup-core-boot"
POKY_DEFAULT_EXTRA_RRECOMMENDS = "kernel-module-af-packet"

DISTRO_FEATURES ?= "${DISTRO_FEATURES_DEFAULT} ${POKY_DEFAULT_DISTRO_FEATURES}"

PREFERRED_VERSION_linux-rockchip ?= "6.1%"
PREFERRED_VERSION_linux-rockchip-rt ?= "6.1%"

SDK_NAME = "${DISTRO}-${TCLIBC}-${SDKMACHINE}-${IMAGE_BASENAME}-${TUNE_PKGARCH}-${MACHINE}"
SDKPATHINSTALL = "/opt/${DISTRO}/${SDK_VERSION}"

DISTRO_EXTRA_RDEPENDS += "${POKY_DEFAULT_EXTRA_RDEPENDS}"
DISTRO_EXTRA_RRECOMMENDS += "${POKY_DEFAULT_EXTRA_RRECOMMENDS}"

TCLIBCAPPEND = ""

BB_SIGNATURE_HANDLER ?= "OEEquivHash"
BB_HASHSERVE ??= "auto"

TOOLCHAIN_TARGET_TASK:remove = "target-sdk-provides-dummy"

LICENSE_FLAGS_ACCEPTED = "commercial_gstreamer1.0-libav commercial_gstreamer1.0-plugins-ugly commercial_ffmpeg commercial_mpeg2dec"

INIT_MANAGER = "systemd"

INHERIT += "extrausers"
EXTRA_USERS_PARAMS += "usermod -a -G audio weston"

IMAGE_INSTALL:append = " e2fsprogs-resize2fs cloud-utils-growpart tn-growpart-helper zram "
IMAGE_INSTALL:append = " glmark2"
IMAGE_INSTALL:append = " chromium-ozone-wayland"
IMAGE_INSTALL:append = " gstreamer1.0 gstreamer1.0-libav gstreamer1.0-plugins-bad gstreamer1.0-plugins-base gstreamer1.0-plugins-ugly gstreamer1.0-plugins-good gstreamer1.0-rockchip"
IMAGE_INSTALL:append = " mpeg2dec coreutils usbutils"
IMAGE_INSTALL:append = " alsa-utils rockchip-alsa-config pulseaudio-server alsa-plugins-pulseaudio-conf"
IMAGE_INSTALL:append = " pulseaudio"
IMAGE_INSTALL:append = " pavucontrol"
IMAGE_INSTALL:append = " qtbase qtwayland qtdeclarative"
IMAGE_INSTALL:append = " v4l-utils"
IMAGE_INSTALL:append = " connman connman-client iw wpa-supplicant bluez5 bt-init-service hostapd iptables bluez5-obex bluez5-noinst-tools glibc-gconv-utf-16 glibc-utils"
IMAGE_INSTALL:append = " pulseaudio-module-alsa-sink pulseaudio-module-bluetooth-discover pulseaudio-module-bluetooth-policy pulseaudio-module-bluez5-discover pulseaudio-module-bluez5-device bluealsa alsa-lib bluealsa-conf"
IMAGE_INSTALL:append = " dialog jq stress-ng memtester bc expect"
IMAGE_INSTALL:append = " rknn-demo rknn-llm-demo"
IMAGE_INSTALL:append = " libgomp"
IMAGE_INSTALL:append = " watchdog"
IMAGE_INSTALL:append = " iperf2 iperf3 ethtool"
IMAGE_INSTALL:append = " pciutils"
IMAGE_INSTALL:append = " ioping"

DISTRO_FEATURES_NATIVESDK:append = " wayland"
DISTRO_FEATURES:append = " gles2 wayland"
DISTRO_FEATURES:append = " pam"
DISTRO_FEATURES:remove = "directfb"
DISTRO_FEATURES:append = " egl"

BBMASK += "/meta-browser/meta-chromium/recipes-browser/chromium/gn-native_.*\.bb"

TOOLCHAIN_TARGET_TASK:append = " qtdeclarative-staticdev"
```

## conf/machine/rockchip-rk3576-evb.conf
```bitbake
# Copyright (c) 2024, LC Wang, Ltd.
# LC Wang <zaq14760@gmail.com>
# Released under the MIT license (see COPYING.MIT for the terms)

#@TYPE: Machine
#@NAME: WAFER-RK3588

require conf/machine/include/rk3576.inc

PREFERRED_VERSION_linux-rockchip = "6.1%"
LINUXLIBCVERSION = "6.1-custom%"

KERNEL_DEVICETREE = "rockchip/rk3576-evb1-v10-linux.dtb"
KBUILD_DEFCONFIG = "rockchip_linux_defconfig"

UBOOT_MACHINE = "rk3576_defconfig"

RK_WIFIBT_RRECOMMENDS = " \
    rkwifibt-firmware-ap6275p-wifi \
    rkwifibt-firmware-ap6275-bt \
    brcm-tools \
"
```
